## arch/arm/soc/st_stm32/stm32f2/Kconfig.defconfig.series
```kconfig
# Kconfig - ST Microelectronics STM32F2 MCU line
#
# Copyright (c) 2016 RnDity Sp. z o.o.
# Copyright (c) 2017 Jérôme Guéry
#
# SPDX-License-Identifier: Apache-2.0
#

if SOC_SERIES_STM32F2X

source "arch/arm/soc/st_stm32/stm32f2/Kconfig.defconfig.stm32f2*"

config SOC_SERIES
	default stm32f2

config SERIAL
	def_bool y

if SERIAL

config CONSOLE
	def_bool y

config UART_CONSOLE
	def_bool y

config UART_STM32
	def_bool y

endif #SERIAL

if GPIO

config GPIO_STM32
	def_bool y

config GPIO_STM32_PORTA
	def_bool y

config GPIO_STM32_PORTB
	def_bool y

config GPIO_STM32_PORTC
	def_bool y

endif #GPIO

if PINMUX

config PINMUX_STM32
	def_bool y

endif #PINMUX

if WATCHDOG

config IWDG_STM32
	def_bool y

endif # WATCHDOG

endif # SOC_SERIES_STM32F2X
```

## arch/arm/soc/st_stm32/stm32f2/Kconfig.defconfig.stm32f205xx
```kconfig
# Kconfig - ST Microelectronics STM32F205XX MCU
#
# Copyright (c) 2016 RnDity Sp. z o.o.
# Copyright (c) 2017 Jérôme Guéry
#
# SPDX-License-Identifier: Apache-2.0
#

if SOC_STM32F205XX

config SOC
	string
	default stm32f205xx

config FLASH_PAGE_SIZE
	hex
	default 0x800

config NUM_IRQS
	int
	default 80

endif # SOC_STM32F205XX
```

## arch/arm/soc/st_stm32/stm32f2/Kconfig.series
```kconfig
# Kconfig - ST Microelectronics STM32F2 MCU series
#
# Copyright (c) 2016 RnDity Sp. z o.o.
# Copyright (c) 2017 Jérôme Guéry
#
# SPDX-License-Identifier: Apache-2.0
#

config SOC_SERIES_STM32F2X
	bool "STM32F2x Series MCU"
	select CPU_CORTEX_M
	select CPU_CORTEX_M3
	select SOC_FAMILY_STM32
	select SYS_POWER_LOW_POWER_STATE_SUPPORTED
	select CPU_HAS_SYSTICK
	select HAS_STM32CUBE
	select CLOCK_CONTROL_STM32_CUBE if CLOCK_CONTROL
	help
	 Enable support for STM32F2 MCU series
```

## arch/arm/soc/st_stm32/stm32f2/Kconfig.soc
```kconfig
# Kconfig - ST Microelectronics STM32F2 MCU line
#
# Copyright (c) 2016 RnDity Sp. z o.o.
# Copyright (c) 2017 Jérôme Guéry
#
# SPDX-License-Identifier: Apache-2.0
#

choice
prompt "STM32F2x MCU Selection"
depends on SOC_SERIES_STM32F2X

config SOC_STM32F205XX
	bool "STM32F205XX"

endchoice
```

## boards/arm/redbear_duo/Kconfig.board
```kconfig
# Kconfig - REDBEAR Duo board configuration
#
# Copyright (c) 2017 Jérôme Guéry.
#
# SPDX-License-Identifier: Apache-2.0
#

config BOARD_REDBEAR_DUO
	bool "Redbear Duo"
	select I2C_1 if I2C
	depends on SOC_STM32F205XX
```

## boards/arm/redbear_duo/Kconfig.defconfig
```kconfig
# Kconfig - STM32F4DISCOVERY board configuration
#
# Copyright (c) 2016 Jérôme Guéry
#
# SPDX-License-Identifier: Apache-2.0
#

if BOARD_REDBEAR_DUO

config BOARD
	default redbear_duo

if I2C_1

config I2C_1_DEFAULT_CFG
	default 0x14

endif # I2C_1

endif # BOARD_REDBEAR_DUO
```

## boards/arm/redbear_duo/redbear_duo_defconfig
```kconfig
CONFIG_ARM=y
CONFIG_BOARD_REDBEAR_DUO=y
CONFIG_SOC_SERIES_STM32F2X=y
CONFIG_SOC_STM32F205XX=y
# 120MHz system clock
CONFIG_SYS_CLOCK_HW_CYCLES_PER_SEC=120000000
CONFIG_SYS_CLOCK_TICKS_PER_SEC=1000

# Enable MPU
CONFIG_STM32_ARM_MPU_ENABLE=y

# enable USART1 - passthrough to STLINK v2 connector
CONFIG_UART_STM32_PORT_1=y
# enable console on this port by default
CONFIG_UART_CONSOLE_ON_DEV_NAME="UART_1"

# enable pinmux
CONFIG_PINMUX=y

# enable GPIO ports A, B, C
CONFIG_GPIO=y
# CONFIG_GPIO_STM32=y
# CONFIG_GPIO_STM32_PORTA=y
# CONFIG_GPIO_STM32_PORTB=y
# CONFIG_GPIO_STM32_PORTC=y

# clock configuration
CONFIG_CLOCK_CONTROL=y

# Clock configuration for Cube Clock control driver
CONFIG_CLOCK_STM32_HSE_CLOCK=26000000
CONFIG_CLOCK_STM32_SYSCLK_SRC_PLL=y
# use HSE as PLL input
CONFIG_CLOCK_STM32_PLL_SRC_HSE=y
# produce 120MHz clock at PLL output
CONFIG_CLOCK_STM32_PLL_M_DIVISOR=26
CONFIG_CLOCK_STM32_PLL_N_MULTIPLIER=240
CONFIG_CLOCK_STM32_PLL_P_DIVISOR=2
CONFIG_CLOCK_STM32_PLL_Q_DIVISOR=5
CONFIG_CLOCK_STM32_AHB_PRESCALER=1
CONFIG_CLOCK_STM32_APB1_PRESCALER=4
CONFIG_CLOCK_STM32_APB2_PRESCALER=2

#enable pwm
CONFIG_PWM=y
CONFIG_PWM_STM32=y
CONFIG_PWM_STM32_1=y
CONFIG_PWM_STM32_2=y

#enable I2C
CONFIG_I2C=y
CONFIG_I2C_STM32_V2=y
```
